## src/mainboard/gpd/Kconfig
```kconfig
## SPDX-License-Identifier: GPL-2.0-only

if VENDOR_GPD

choice
	prompt "Mainboard model"

source "src/mainboard/gpd/*/Kconfig.name"

endchoice

source "src/mainboard/gpd/*/Kconfig"

config MAINBOARD_VENDOR
	default "GPD"

endif # VENDOR_GPD
```

## src/mainboard/gpd/micropc/Kconfig
```kconfig
if BOARD_GPD_MICROPC

config BOARD_SPECIFIC_OPTIONS
	def_bool y
	select SOC_INTEL_GEMINILAKE
	select BOARD_ROMSIZE_KB_8192
	select HAVE_ACPI_RESUME
	select HAVE_ACPI_TABLES
	select INTEL_LPSS_UART_FOR_CONSOLE
	select SYSTEM_TYPE_LAPTOP
	select SUPERIO_ITE_IT8786E

config MAINBOARD_DIR
	default "gpd/micropc"

config MAINBOARD_PART_NUMBER
	default "MicroPC"

config DIMM_SPD_SIZE
	default 512

endif # BOARD_GPD_MICROPC
```

## src/mainboard/hardkernel/odroid-h4/Kconfig.name
```kconfig
## SPDX-License-Identifier: GPL-2.0-only

config BOARD_HARDKERNEL_ODROID_H4
	bool "Odroid H4"
```
